## config/boards/arm/adv360/Kconfig
```kconfig
# SPDX-License-Identifier: MIT

config BOARD_ENABLE_DCDC
    bool "Enable DCDC mode"
    select SOC_DCDC_NRF52X
    default y
    depends on BOARD_ADV360_LEFT || BOARD_ADV360_RIGHT

menu "Combo options"

config ZMK_COMBO_MAX_PRESSED_COMBOS
    int "Maximum number of currently pressed combos"
    default 60

config ZMK_COMBO_MAX_COMBOS_PER_KEY
    int "Maximum number of combos per key"
    default 60

config ZMK_COMBO_MAX_KEYS_PER_COMBO
    int "Maximum number of keys per combo"
    default 60

# Combo options
endmenu
```
